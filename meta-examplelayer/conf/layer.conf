## meta-examplelayer/conf/layer.conf
```bitbake
# We have a conf and classes directory, add to BBPATH
BBPATH .= ":${LAYERDIR}"

# We have recipes-* directories, add to BBFILES
BBFILES += "${LAYERDIR}/recipes-*/*/*.bb \
            ${LAYERDIR}/recipes-*/*/*.bbappend"

BBFILE_COLLECTIONS += "meta-examplelayer"
BBFILE_PATTERN_meta-examplelayer = "^${LAYERDIR}/"
BBFILE_PRIORITY_meta-examplelayer = "6"

LAYERDEPENDS_meta-examplelayer = "core"
LAYERSERIES_COMPAT_meta-examplelayer = "styhead walnascar"
```
